VERSION ""

NS_ :

BS_:

BU_: XXX

BO_ 933 RADAR_TRACK_3a5: 24 RADAR
 SG_ VALID : 25|2@0+ (1,0) [0|3] "" XXX
 SG_ VALID2 : 28|2@0+ (1,0) [0|3] "" XXX
 SG_ PROB : 30|10@1+ (1,0) [0|1023] "" XXX
 SG_ VALID_CNT : 47|8@0+ (1,0) [0|255] "" XXX
 SG_ LONG_DIST : 63|13@1+ (0.05,0) [0|409.55] "m" XXX
 SG_ LAT_DIST : 76|12@1- (0.05,0) [-102.4|102.35] "m" XXX
 SG_ REL_SPEED : 88|14@1- (0.01,0) [-81.92|81.91] "m/s" XXX
 SG_ IN_MYLANE : 103|2@0+ (1,0) [0|3] "" XXX
 SG_ LAT_SPEED : 104|13@1- (0.01,0) [-40.96|40.95] "m/s" XXX
 SG_ REL_ACCEL : 118|10@1- (0.05,0) [-25.6|25.55] "m/s^2" XXX

BO_ 934 RADAR_TRACK_3a6: 24 RADAR
 SG_ VALID : 25|2@0+ (1,0) [0|3] "" XXX
 SG_ VALID2 : 28|2@0+ (1,0) [0|3] "" XXX
 SG_ PROB : 30|10@1+ (1,0) [0|1023] "" XXX
 SG_ VALID_CNT : 47|8@0+ (1,0) [0|255] "" XXX
 SG_ LONG_DIST : 63|13@1+ (0.05,0) [0|409.55] "m" XXX
 SG_ LAT_DIST : 76|12@1- (0.05,0) [-102.4|102.35] "m" XXX
 SG_ REL_SPEED : 88|14@1- (0.01,0) [-81.92|81.91] "m/s" XXX
 SG_ IN_MYLANE : 103|2@0+ (1,0) [0|3] "" XXX
 SG_ LAT_SPEED : 104|13@1- (0.01,0) [-40.96|40.95] "m/s" XXX
 SG_ REL_ACCEL : 118|10@1- (0.05,0) [-25.6|25.55] "m/s^2" XXX

BO_ 935 RADAR_TRACK_3a7: 24 RADAR
 SG_ VALID : 25|2@0+ (1,0) [0|3] "" XXX
 SG_ VALID2 : 28|2@0+ (1,0) [0|3] "" XXX
 SG_ PROB : 30|10@1+ (1,0) [0|1023] "" XXX
 SG_ VALID_CNT : 47|8@0+ (1,0) [0|255] "" XXX
 SG_ LONG_DIST : 63|13@1+ (0.05,0) [0|409.55] "m" XXX
 SG_ LAT_DIST : 76|12@1- (0.05,0) [-102.4|102.35] "m" XXX
 SG_ REL_SPEED : 88|14@1- (0.01,0) [-81.92|81.91] "m/s" XXX
 SG_ IN_MYLANE : 103|2@0+ (1,0) [0|3] "" XXX
 SG_ LAT_SPEED : 104|13@1- (0.01,0) [-40.96|40.95] "m/s" XXX
 SG_ REL_ACCEL : 118|10@1- (0.05,0) [-25.6|25.55] "m/s^2" XXX

BO_ 936 RADAR_TRACK_3a8: 24 RADAR
 SG_ VALID : 25|2@0+ (1,0) [0|3] "" XXX
 SG_ VALID2 : 28|2@0+ (1,0) [0|3] "" XXX
 SG_ PROB : 30|10@1+ (1,0) [0|1023] "" XXX
 SG_ VALID_CNT : 47|8@0+ (1,0) [0|255] "" XXX
 SG_ LONG_DIST : 63|13@1+ (0.05,0) [0|409.55] "m" XXX
 SG_ LAT_DIST : 76|12@1- (0.05,0) [-102.4|102.35] "m" XXX
 SG_ REL_SPEED : 88|14@1- (0.01,0) [-81.92|81.91] "m/s" XXX
 SG_ IN_MYLANE : 103|2@0+ (1,0) [0|3] "" XXX
 SG_ LAT_SPEED : 104|13@1- (0.01,0) [-40.96|40.95] "m/s" XXX
 SG_ REL_ACCEL : 118|10@1- (0.05,0) [-25.6|25.55] "m/s^2" XXX

BO_ 937 RADAR_TRACK_3a9: 24 RADAR
 SG_ VALID : 25|2@0+ (1,0) [0|3] "" XXX
 SG_ VALID2 : 28|2@0+ (1,0) [0|3] "" XXX
 SG_ PROB : 30|10@1+ (1,0) [0|1023] "" XXX
 SG_ VALID_CNT : 47|8@0+ (1,0) [0|255] "" XXX
 SG_ LONG_DIST : 63|13@1+ (0.05,0) [0|409.55] "m" XXX
 SG_ LAT_DIST : 76|12@1- (0.05,0) [-102.4|102.35] "m" XXX
 SG_ REL_SPEED : 88|14@1- (0.01,0) [-81.92|81.91] "m/s" XXX
 SG_ IN_MYLANE : 103|2@0+ (1,0) [0|3] "" XXX
 SG_ LAT_SPEED : 104|13@1- (0.01,0) [-40.96|40.95] "m/s" XXX
 SG_ REL_ACCEL : 118|10@1- (0.05,0) [-25.6|25.55] "m/s^2" XXX

BO_ 938 RADAR_TRACK_3aa: 24 RADAR
 SG_ VALID : 25|2@0+ (1,0) [0|3] "" XXX
 SG_ VALID2 : 28|2@0+ (1,0) [0|3] "" XXX
 SG_ PROB : 30|10@1+ (1,0) [0|1023] "" XXX
 SG_ VALID_CNT : 47|8@0+ (1,0) [0|255] "" XXX
 SG_ LONG_DIST : 63|13@1+ (0.05,0) [0|409.55] "m" XXX
 SG_ LAT_DIST : 76|12@1- (0.05,0) [-102.4|102.35] "m" XXX
 SG_ REL_SPEED : 88|14@1- (0.01,0) [-81.92|81.91] "m/s" XXX
 SG_ IN_MYLANE : 103|2@0+ (1,0) [0|3] "" XXX
 SG_ LAT_SPEED : 104|13@1- (0.01,0) [-40.96|40.95] "m/s" XXX
 SG_ REL_ACCEL : 118|10@1- (0.05,0) [-25.6|25.55] "m/s^2" XXX

BO_ 939 RADAR_TRACK_3ab: 24 RADAR
 SG_ VALID : 25|2@0+ (1,0) [0|3] "" XXX
 SG_ VALID2 : 28|2@0+ (1,0) [0|3] "" XXX
 SG_ PROB : 30|10@1+ (1,0) [0|1023] "" XXX
 SG_ VALID_CNT : 47|8@0+ (1,0) [0|255] "" XXX
 SG_ LONG_DIST : 63|13@1+ (0.05,0) [0|409.55] "m" XXX
 SG_ LAT_DIST : 76|12@1- (0.05,0) [-102.4|102.35] "m" XXX
 SG_ REL_SPEED : 88|14@1- (0.01,0) [-81.92|81.91] "m/s" XXX
 SG_ IN_MYLANE : 103|2@0+ (1,0) [0|3] "" XXX
 SG_ LAT_SPEED : 104|13@1- (0.01,0) [-40.96|40.95] "m/s" XXX
 SG_ REL_ACCEL : 118|10@1- (0.05,0) [-25.6|25.55] "m/s^2" XXX

BO_ 940 RADAR_TRACK_3ac: 24 RADAR
 SG_ VALID : 25|2@0+ (1,0) [0|3] "" XXX
 SG_ VALID2 : 28|2@0+ (1,0) [0|3] "" XXX
 SG_ PROB : 30|10@1+ (1,0) [0|1023] "" XXX
 SG_ VALID_CNT : 47|8@0+ (1,0) [0|255] "" XXX
 SG_ LONG_DIST : 63|13@1+ (0.05,0) [0|409.55] "m" XXX
 SG_ LAT_DIST : 76|12@1- (0.05,0) [-102.4|102.35] "m" XXX
 SG_ REL_SPEED : 88|14@1- (0.01,0) [-81.92|81.91] "m/s" XXX
 SG_ IN_MYLANE : 103|2@0+ (1,0) [0|3] "" XXX
 SG_ LAT_SPEED : 104|13@1- (0.01,0) [-40.96|40.95] "m/s" XXX
 SG_ REL_ACCEL : 118|10@1- (0.05,0) [-25.6|25.55] "m/s^2" XXX

BO_ 941 RADAR_TRACK_3ad: 24 RADAR
 SG_ VALID : 25|2@0+ (1,0) [0|3] "" XXX
 SG_ VALID2 : 28|2@0+ (1,0) [0|3] "" XXX
 SG_ PROB : 30|10@1+ (1,0) [0|1023] "" XXX
 SG_ VALID_CNT : 47|8@0+ (1,0) [0|255] "" XXX
 SG_ LONG_DIST : 63|13@1+ (0.05,0) [0|409.55] "m" XXX
 SG_ LAT_DIST : 76|12@1- (0.05,0) [-102.4|102.35] "m" XXX
 SG_ REL_SPEED : 88|14@1- (0.01,0) [-81.92|81.91] "m/s" XXX
 SG_ IN_MYLANE : 103|2@0+ (1,0) [0|3] "" XXX
 SG_ LAT_SPEED : 104|13@1- (0.01,0) [-40.96|40.95] "m/s" XXX
 SG_ REL_ACCEL : 118|10@1- (0.05,0) [-25.6|25.55] "m/s^2" XXX

BO_ 942 RADAR_TRACK_3ae: 24 RADAR
 SG_ VALID : 25|2@0+ (1,0) [0|3] "" XXX
 SG_ VALID2 : 28|2@0+ (1,0) [0|3] "" XXX
 SG_ PROB : 30|10@1+ (1,0) [0|1023] "" XXX
 SG_ VALID_CNT : 47|8@0+ (1,0) [0|255] "" XXX
 SG_ LONG_DIST : 63|13@1+ (0.05,0) [0|409.55] "m" XXX
 SG_ LAT_DIST : 76|12@1- (0.05,0) [-102.4|102.35] "m" XXX
 SG_ REL_SPEED : 88|14@1- (0.01,0) [-81.92|81.91] "m/s" XXX
 SG_ IN_MYLANE : 103|2@0+ (1,0) [0|3] "" XXX
 SG_ LAT_SPEED : 104|13@1- (0.01,0) [-40.96|40.95] "m/s" XXX
 SG_ REL_ACCEL : 118|10@1- (0.05,0) [-25.6|25.55] "m/s^2" XXX

BO_ 943 RADAR_TRACK_3af: 24 RADAR
 SG_ VALID : 25|2@0+ (1,0) [0|3] "" XXX
 SG_ VALID2 : 28|2@0+ (1,0) [0|3] "" XXX
 SG_ PROB : 30|10@1+ (1,0) [0|1023] "" XXX
 SG_ VALID_CNT : 47|8@0+ (1,0) [0|255] "" XXX
 SG_ LONG_DIST : 63|13@1+ (0.05,0) [0|409.55] "m" XXX
 SG_ LAT_DIST : 76|12@1- (0.05,0) [-102.4|102.35] "m" XXX
 SG_ REL_SPEED : 88|14@1- (0.01,0) [-81.92|81.91] "m/s" XXX
 SG_ IN_MYLANE : 103|2@0+ (1,0) [0|3] "" XXX
 SG_ LAT_SPEED : 104|13@1- (0.01,0) [-40.96|40.95] "m/s" XXX
 SG_ REL_ACCEL : 118|10@1- (0.05,0) [-25.6|25.55] "m/s^2" XXX

BO_ 944 RADAR_TRACK_3b0: 24 RADAR
 SG_ VALID : 25|2@0+ (1,0) [0|3] "" XXX
 SG_ VALID2 : 28|2@0+ (1,0) [0|3] "" XXX
 SG_ PROB : 30|10@1+ (1,0) [0|1023] "" XXX
 SG_ VALID_CNT : 47|8@0+ (1,0) [0|255] "" XXX
 SG_ LONG_DIST : 63|13@1+ (0.05,0) [0|409.55] "m" XXX
 SG_ LAT_DIST : 76|12@1- (0.05,0) [-102.4|102.35] "m" XXX
 SG_ REL_SPEED : 88|14@1- (0.01,0) [-81.92|81.91] "m/s" XXX
 SG_ IN_MYLANE : 103|2@0+ (1,0) [0|3] "" XXX
 SG_ LAT_SPEED : 104|13@1- (0.01,0) [-40.96|40.95] "m/s" XXX
 SG_ REL_ACCEL : 118|10@1- (0.05,0) [-25.6|25.55] "m/s^2" XXX

BO_ 945 RADAR_TRACK_3b1: 24 RADAR
 SG_ VALID : 25|2@0+ (1,0) [0|3] "" XXX
 SG_ VALID2 : 28|2@0+ (1,0) [0|3] "" XXX
 SG_ PROB : 30|10@1+ (1,0) [0|1023] "" XXX
 SG_ VALID_CNT : 47|8@0+ (1,0) [0|255] "" XXX
 SG_ LONG_DIST : 63|13@1+ (0.05,0) [0|409.55] "m" XXX
 SG_ LAT_DIST : 76|12@1- (0.05,0) [-102.4|102.35] "m" XXX
 SG_ REL_SPEED : 88|14@1- (0.01,0) [-81.92|81.91] "m/s" XXX
 SG_ IN_MYLANE : 103|2@0+ (1,0) [0|3] "" XXX
 SG_ LAT_SPEED : 104|13@1- (0.01,0) [-40.96|40.95] "m/s" XXX
 SG_ REL_ACCEL : 118|10@1- (0.05,0) [-25.6|25.55] "m/s^2" XXX

BO_ 946 RADAR_TRACK_3b2: 24 RADAR
 SG_ VALID : 25|2@0+ (1,0) [0|3] "" XXX
 SG_ VALID2 : 28|2@0+ (1,0) [0|3] "" XXX
 SG_ PROB : 30|10@1+ (1,0) [0|1023] "" XXX
 SG_ VALID_CNT : 47|8@0+ (1,0) [0|255] "" XXX
 SG_ LONG_DIST : 63|13@1+ (0.05,0) [0|409.55] "m" XXX
 SG_ LAT_DIST : 76|12@1- (0.05,0) [-102.4|102.35] "m" XXX
 SG_ REL_SPEED : 88|14@1- (0.01,0) [-81.92|81.91] "m/s" XXX
 SG_ IN_MYLANE : 103|2@0+ (1,0) [0|3] "" XXX
 SG_ LAT_SPEED : 104|13@1- (0.01,0) [-40.96|40.95] "m/s" XXX
 SG_ REL_ACCEL : 118|10@1- (0.05,0) [-25.6|25.55] "m/s^2" XXX

BO_ 947 RADAR_TRACK_3b3: 24 RADAR
 SG_ VALID : 25|2@0+ (1,0) [0|3] "" XXX
 SG_ VALID2 : 28|2@0+ (1,0) [0|3] "" XXX
 SG_ PROB : 30|10@1+ (1,0) [0|1023] "" XXX
 SG_ VALID_CNT : 47|8@0+ (1,0) [0|255] "" XXX
 SG_ LONG_DIST : 63|13@1+ (0.05,0) [0|409.55] "m" XXX
 SG_ LAT_DIST : 76|12@1- (0.05,0) [-102.4|102.35] "m" XXX
 SG_ REL_SPEED : 88|14@1- (0.01,0) [-81.92|81.91] "m/s" XXX
 SG_ IN_MYLANE : 103|2@0+ (1,0) [0|3] "" XXX
 SG_ LAT_SPEED : 104|13@1- (0.01,0) [-40.96|40.95] "m/s" XXX
 SG_ REL_ACCEL : 118|10@1- (0.05,0) [-25.6|25.55] "m/s^2" XXX

BO_ 948 RADAR_TRACK_3b4: 24 RADAR
 SG_ VALID : 25|2@0+ (1,0) [0|3] "" XXX
 SG_ VALID2 : 28|2@0+ (1,0) [0|3] "" XXX
 SG_ PROB : 30|10@1+ (1,0) [0|1023] "" XXX
 SG_ VALID_CNT : 47|8@0+ (1,0) [0|255] "" XXX
 SG_ LONG_DIST : 63|13@1+ (0.05,0) [0|409.55] "m" XXX
 SG_ LAT_DIST : 76|12@1- (0.05,0) [-102.4|102.35] "m" XXX
 SG_ REL_SPEED : 88|14@1- (0.01,0) [-81.92|81.91] "m/s" XXX
 SG_ IN_MYLANE : 103|2@0+ (1,0) [0|3] "" XXX
 SG_ LAT_SPEED : 104|13@1- (0.01,0) [-40.96|40.95] "m/s" XXX
 SG_ REL_ACCEL : 118|10@1- (0.05,0) [-25.6|25.55] "m/s^2" XXX

BO_ 949 RADAR_TRACK_3b5: 24 RADAR
 SG_ VALID : 25|2@0+ (1,0) [0|3] "" XXX
 SG_ VALID2 : 28|2@0+ (1,0) [0|3] "" XXX
 SG_ PROB : 30|10@1+ (1,0) [0|1023] "" XXX
 SG_ VALID_CNT : 47|8@0+ (1,0) [0|255] "" XXX
 SG_ LONG_DIST : 63|13@1+ (0.05,0) [0|409.55] "m" XXX
 SG_ LAT_DIST : 76|12@1- (0.05,0) [-102.4|102.35] "m" XXX
 SG_ REL_SPEED : 88|14@1- (0.01,0) [-81.92|81.91] "m/s" XXX
 SG_ IN_MYLANE : 103|2@0+ (1,0) [0|3] "" XXX
 SG_ LAT_SPEED : 104|13@1- (0.01,0) [-40.96|40.95] "m/s" XXX
 SG_ REL_ACCEL : 118|10@1- (0.05,0) [-25.6|25.55] "m/s^2" XXX

BO_ 950 RADAR_TRACK_3b6: 24 RADAR
 SG_ VALID : 25|2@0+ (1,0) [0|3] "" XXX
 SG_ VALID2 : 28|2@0+ (1,0) [0|3] "" XXX
 SG_ PROB : 30|10@1+ (1,0) [0|1023] "" XXX
 SG_ VALID_CNT : 47|8@0+ (1,0) [0|255] "" XXX
 SG_ LONG_DIST : 63|13@1+ (0.05,0) [0|409.55] "m" XXX
 SG_ LAT_DIST : 76|12@1- (0.05,0) [-102.4|102.35] "m" XXX
 SG_ REL_SPEED : 88|14@1- (0.01,0) [-81.92|81.91] "m/s" XXX
 SG_ IN_MYLANE : 103|2@0+ (1,0) [0|3] "" XXX
 SG_ LAT_SPEED : 104|13@1- (0.01,0) [-40.96|40.95] "m/s" XXX
 SG_ REL_ACCEL : 118|10@1- (0.05,0) [-25.6|25.55] "m/s^2" XXX

BO_ 951 RADAR_TRACK_3b7: 24 RADAR
 SG_ VALID : 25|2@0+ (1,0) [0|3] "" XXX
 SG_ VALID2 : 28|2@0+ (1,0) [0|3] "" XXX
 SG_ PROB : 30|10@1+ (1,0) [0|1023] "" XXX
 SG_ VALID_CNT : 47|8@0+ (1,0) [0|255] "" XXX
 SG_ LONG_DIST : 63|13@1+ (0.05,0) [0|409.55] "m" XXX
 SG_ LAT_DIST : 76|12@1- (0.05,0) [-102.4|102.35] "m" XXX
 SG_ REL_SPEED : 88|14@1- (0.01,0) [-81.92|81.91] "m/s" XXX
 SG_ IN_MYLANE : 103|2@0+ (1,0) [0|3] "" XXX
 SG_ LAT_SPEED : 104|13@1- (0.01,0) [-40.96|40.95] "m/s" XXX
 SG_ REL_ACCEL : 118|10@1- (0.05,0) [-25.6|25.55] "m/s^2" XXX

BO_ 952 RADAR_TRACK_3b8: 24 RADAR
 SG_ VALID : 25|2@0+ (1,0) [0|3] "" XXX
 SG_ VALID2 : 28|2@0+ (1,0) [0|3] "" XXX
 SG_ PROB : 30|10@1+ (1,0) [0|1023] "" XXX
 SG_ VALID_CNT : 47|8@0+ (1,0) [0|255] "" XXX
 SG_ LONG_DIST : 63|13@1+ (0.05,0) [0|409.55] "m" XXX
 SG_ LAT_DIST : 76|12@1- (0.05,0) [-102.4|102.35] "m" XXX
 SG_ REL_SPEED : 88|14@1- (0.01,0) [-81.92|81.91] "m/s" XXX
 SG_ IN_MYLANE : 103|2@0+ (1,0) [0|3] "" XXX
 SG_ LAT_SPEED : 104|13@1- (0.01,0) [-40.96|40.95] "m/s" XXX
 SG_ REL_ACCEL : 118|10@1- (0.05,0) [-25.6|25.55] "m/s^2" XXX

BO_ 953 RADAR_TRACK_3b9: 24 RADAR
 SG_ VALID : 25|2@0+ (1,0) [0|3] "" XXX
 SG_ VALID2 : 28|2@0+ (1,0) [0|3] "" XXX
 SG_ PROB : 30|10@1+ (1,0) [0|1023] "" XXX
 SG_ VALID_CNT : 47|8@0+ (1,0) [0|255] "" XXX
 SG_ LONG_DIST : 63|13@1+ (0.05,0) [0|409.55] "m" XXX
 SG_ LAT_DIST : 76|12@1- (0.05,0) [-102.4|102.35] "m" XXX
 SG_ REL_SPEED : 88|14@1- (0.01,0) [-81.92|81.91] "m/s" XXX
 SG_ IN_MYLANE : 103|2@0+ (1,0) [0|3] "" XXX
 SG_ LAT_SPEED : 104|13@1- (0.01,0) [-40.96|40.95] "m/s" XXX
 SG_ REL_ACCEL : 118|10@1- (0.05,0) [-25.6|25.55] "m/s^2" XXX

BO_ 954 RADAR_TRACK_3ba: 24 RADAR
 SG_ VALID : 25|2@0+ (1,0) [0|3] "" XXX
 SG_ VALID2 : 28|2@0+ (1,0) [0|3] "" XXX
 SG_ PROB : 30|10@1+ (1,0) [0|1023] "" XXX
 SG_ VALID_CNT : 47|8@0+ (1,0) [0|255] "" XXX
 SG_ LONG_DIST : 63|13@1+ (0.05,0) [0|409.55] "m" XXX
 SG_ LAT_DIST : 76|12@1- (0.05,0) [-102.4|102.35] "m" XXX
 SG_ REL_SPEED : 88|14@1- (0.01,0) [-81.92|81.91] "m/s" XXX
 SG_ IN_MYLANE : 103|2@0+ (1,0) [0|3] "" XXX
 SG_ LAT_SPEED : 104|13@1- (0.01,0) [-40.96|40.95] "m/s" XXX
 SG_ REL_ACCEL : 118|10@1- (0.05,0) [-25.6|25.55] "m/s^2" XXX

BO_ 955 RADAR_TRACK_3bb: 24 RADAR
 SG_ VALID : 25|2@0+ (1,0) [0|3] "" XXX
 SG_ VALID2 : 28|2@0+ (1,0) [0|3] "" XXX
 SG_ PROB : 30|10@1+ (1,0) [0|1023] "" XXX
 SG_ VALID_CNT : 47|8@0+ (1,0) [0|255] "" XXX
 SG_ LONG_DIST : 63|13@1+ (0.05,0) [0|409.55] "m" XXX
 SG_ LAT_DIST : 76|12@1- (0.05,0) [-102.4|102.35] "m" XXX
 SG_ REL_SPEED : 88|14@1- (0.01,0) [-81.92|81.91] "m/s" XXX
 SG_ IN_MYLANE : 103|2@0+ (1,0) [0|3] "" XXX
 SG_ LAT_SPEED : 104|13@1- (0.01,0) [-40.96|40.95] "m/s" XXX
 SG_ REL_ACCEL : 118|10@1- (0.05,0) [-25.6|25.55] "m/s^2" XXX

BO_ 956 RADAR_TRACK_3bc: 24 RADAR
 SG_ VALID : 25|2@0+ (1,0) [0|3] "" XXX
 SG_ VALID2 : 28|2@0+ (1,0) [0|3] "" XXX
 SG_ PROB : 30|10@1+ (1,0) [0|1023] "" XXX
 SG_ VALID_CNT : 47|8@0+ (1,0) [0|255] "" XXX
 SG_ LONG_DIST : 63|13@1+ (0.05,0) [0|409.55] "m" XXX
 SG_ LAT_DIST : 76|12@1- (0.05,0) [-102.4|102.35] "m" XXX
 SG_ REL_SPEED : 88|14@1- (0.01,0) [-81.92|81.91] "m/s" XXX
 SG_ IN_MYLANE : 103|2@0+ (1,0) [0|3] "" XXX
 SG_ LAT_SPEED : 104|13@1- (0.01,0) [-40.96|40.95] "m/s" XXX
 SG_ REL_ACCEL : 118|10@1- (0.05,0) [-25.6|25.55] "m/s^2" XXX

BO_ 957 RADAR_TRACK_3bd: 24 RADAR
 SG_ VALID : 25|2@0+ (1,0) [0|3] "" XXX
 SG_ VALID2 : 28|2@0+ (1,0) [0|3] "" XXX
 SG_ PROB : 30|10@1+ (1,0) [0|1023] "" XXX
 SG_ VALID_CNT : 47|8@0+ (1,0) [0|255] "" XXX
 SG_ LONG_DIST : 63|13@1+ (0.05,0) [0|409.55] "m" XXX
 SG_ LAT_DIST : 76|12@1- (0.05,0) [-102.4|102.35] "m" XXX
 SG_ REL_SPEED : 88|14@1- (0.01,0) [-81.92|81.91] "m/s" XXX
 SG_ IN_MYLANE : 103|2@0+ (1,0) [0|3] "" XXX
 SG_ LAT_SPEED : 104|13@1- (0.01,0) [-40.96|40.95] "m/s" XXX
 SG_ REL_ACCEL : 118|10@1- (0.05,0) [-25.6|25.55] "m/s^2" XXX

BO_ 958 RADAR_TRACK_3be: 24 RADAR
 SG_ VALID : 25|2@0+ (1,0) [0|3] "" XXX
 SG_ VALID2 : 28|2@0+ (1,0) [0|3] "" XXX
 SG_ PROB : 30|10@1+ (1,0) [0|1023] "" XXX
 SG_ VALID_CNT : 47|8@0+ (1,0) [0|255] "" XXX
 SG_ LONG_DIST : 63|13@1+ (0.05,0) [0|409.55] "m" XXX
 SG_ LAT_DIST : 76|12@1- (0.05,0) [-102.4|102.35] "m" XXX
 SG_ REL_SPEED : 88|14@1- (0.01,0) [-81.92|81.91] "m/s" XXX
 SG_ IN_MYLANE : 103|2@0+ (1,0) [0|3] "" XXX
 SG_ LAT_SPEED : 104|13@1- (0.01,0) [-40.96|40.95] "m/s" XXX
 SG_ REL_ACCEL : 118|10@1- (0.05,0) [-25.6|25.55] "m/s^2" XXX

BO_ 959 RADAR_TRACK_3bf: 24 RADAR
 SG_ VALID : 25|2@0+ (1,0) [0|3] "" XXX
 SG_ VALID2 : 28|2@0+ (1,0) [0|3] "" XXX
 SG_ PROB : 30|10@1+ (1,0) [0|1023] "" XXX
 SG_ VALID_CNT : 47|8@0+ (1,0) [0|255] "" XXX
 SG_ LONG_DIST : 63|13@1+ (0.05,0) [0|409.55] "m" XXX
 SG_ LAT_DIST : 76|12@1- (0.05,0) [-102.4|102.35] "m" XXX
 SG_ REL_SPEED : 88|14@1- (0.01,0) [-81.92|81.91] "m/s" XXX
 SG_ IN_MYLANE : 103|2@0+ (1,0) [0|3] "" XXX
 SG_ LAT_SPEED : 104|13@1- (0.01,0) [-40.96|40.95] "m/s" XXX
 SG_ REL_ACCEL : 118|10@1- (0.05,0) [-25.6|25.55] "m/s^2" XXX

BO_ 960 RADAR_TRACK_3c0: 24 RADAR
 SG_ VALID : 25|2@0+ (1,0) [0|3] "" XXX
 SG_ VALID2 : 28|2@0+ (1,0) [0|3] "" XXX
 SG_ PROB : 30|10@1+ (1,0) [0|1023] "" XXX
 SG_ VALID_CNT : 47|8@0+ (1,0) [0|255] "" XXX
 SG_ LONG_DIST : 63|13@1+ (0.05,0) [0|409.55] "m" XXX
 SG_ LAT_DIST : 76|12@1- (0.05,0) [-102.4|102.35] "m" XXX
 SG_ REL_SPEED : 88|14@1- (0.01,0) [-81.92|81.91] "m/s" XXX
 SG_ IN_MYLANE : 103|2@0+ (1,0) [0|3] "" XXX
 SG_ LAT_SPEED : 104|13@1- (0.01,0) [-40.96|40.95] "m/s" XXX
 SG_ REL_ACCEL : 118|10@1- (0.05,0) [-25.6|25.55] "m/s^2" XXX

BO_ 961 RADAR_TRACK_3c1: 24 RADAR
 SG_ VALID : 25|2@0+ (1,0) [0|3] "" XXX
 SG_ VALID2 : 28|2@0+ (1,0) [0|3] "" XXX
 SG_ PROB : 30|10@1+ (1,0) [0|1023] "" XXX
 SG_ VALID_CNT : 47|8@0+ (1,0) [0|255] "" XXX
 SG_ LONG_DIST : 63|13@1+ (0.05,0) [0|409.55] "m" XXX
 SG_ LAT_DIST : 76|12@1- (0.05,0) [-102.4|102.35] "m" XXX
 SG_ REL_SPEED : 88|14@1- (0.01,0) [-81.92|81.91] "m/s" XXX
 SG_ IN_MYLANE : 103|2@0+ (1,0) [0|3] "" XXX
 SG_ LAT_SPEED : 104|13@1- (0.01,0) [-40.96|40.95] "m/s" XXX
 SG_ REL_ACCEL : 118|10@1- (0.05,0) [-25.6|25.55] "m/s^2" XXX

BO_ 962 RADAR_TRACK_3c2: 24 RADAR
 SG_ VALID : 25|2@0+ (1,0) [0|3] "" XXX
 SG_ VALID2 : 28|2@0+ (1,0) [0|3] "" XXX
 SG_ PROB : 30|10@1+ (1,0) [0|1023] "" XXX
 SG_ VALID_CNT : 47|8@0+ (1,0) [0|255] "" XXX
 SG_ LONG_DIST : 63|13@1+ (0.05,0) [0|409.55] "m" XXX
 SG_ LAT_DIST : 76|12@1- (0.05,0) [-102.4|102.35] "m" XXX
 SG_ REL_SPEED : 88|14@1- (0.01,0) [-81.92|81.91] "m/s" XXX
 SG_ IN_MYLANE : 103|2@0+ (1,0) [0|3] "" XXX
 SG_ LAT_SPEED : 104|13@1- (0.01,0) [-40.96|40.95] "m/s" XXX
 SG_ REL_ACCEL : 118|10@1- (0.05,0) [-25.6|25.55] "m/s^2" XXX

BO_ 963 RADAR_TRACK_3c3: 24 RADAR
 SG_ VALID : 25|2@0+ (1,0) [0|3] "" XXX
 SG_ VALID2 : 28|2@0+ (1,0) [0|3] "" XXX
 SG_ PROB : 30|10@1+ (1,0) [0|1023] "" XXX
 SG_ VALID_CNT : 47|8@0+ (1,0) [0|255] "" XXX
 SG_ LONG_DIST : 63|13@1+ (0.05,0) [0|409.55] "m" XXX
 SG_ LAT_DIST : 76|12@1- (0.05,0) [-102.4|102.35] "m" XXX
 SG_ REL_SPEED : 88|14@1- (0.01,0) [-81.92|81.91] "m/s" XXX
 SG_ IN_MYLANE : 103|2@0+ (1,0) [0|3] "" XXX
 SG_ LAT_SPEED : 104|13@1- (0.01,0) [-40.96|40.95] "m/s" XXX
 SG_ REL_ACCEL : 118|10@1- (0.05,0) [-25.6|25.55] "m/s^2" XXX

BO_ 964 RADAR_TRACK_3c4: 24 RADAR
 SG_ VALID : 25|2@0+ (1,0) [0|3] "" XXX
 SG_ VALID2 : 28|2@0+ (1,0) [0|3] "" XXX
 SG_ PROB : 30|10@1+ (1,0) [0|1023] "" XXX
 SG_ VALID_CNT : 47|8@0+ (1,0) [0|255] "" XXX
 SG_ LONG_DIST : 63|13@1+ (0.05,0) [0|409.55] "m" XXX
 SG_ LAT_DIST : 76|12@1- (0.05,0) [-102.4|102.35] "m" XXX
 SG_ REL_SPEED : 88|14@1- (0.01,0) [-81.92|81.91] "m/s" XXX
 SG_ IN_MYLANE : 103|2@0+ (1,0) [0|3] "" XXX
 SG_ LAT_SPEED : 104|13@1- (0.01,0) [-40.96|40.95] "m/s" XXX
 SG_ REL_ACCEL : 118|10@1- (0.05,0) [-25.6|25.55] "m/s^2" XXX
